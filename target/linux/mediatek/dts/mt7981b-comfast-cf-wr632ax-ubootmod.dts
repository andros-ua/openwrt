// SPDX-License-Identifier: GPL-2.0-or-later OR MIT

#include "mt7981b-comfast-cf-wr632ax-common.dtsi"

/ {
	compatible = "comfast,cf-wr632ax-ubootmod", "mediatek,mt7981";
};

&chosen {
	bootargs = "root=/dev/fit0 rootwait";
};

&partitions {
	partition@0 {
		label = "bl2";
	};
};
