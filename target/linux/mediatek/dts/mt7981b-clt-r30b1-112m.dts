// SPDX-License-Identifier: GPL-2.0-only OR MIT
/dts-v1/;

#include "mt7981b-clt-r30b1-common.dtsi"

/ {
	model = "CLT-R30B1 (112M ubi)";
	compatible = "clt,r30b1-112m", "mediatek,mt7981";
};

&partitions {
	partition@580000 {
		label = "ubi";
		reg = <0x0580000 0x7000000>;
	};
};
